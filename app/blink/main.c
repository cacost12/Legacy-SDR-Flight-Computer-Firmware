/*******************************************************************************
*
* FILE: 
*       main.c
*
* DESCRIPTION: 
*		Flashes the onboard rgb led in order to verify that the flight computer 
*       board and programmer are functioning correctly 
*
*******************************************************************************/

/*------------------------------------------------------------------------------
 Includes                                                                     
------------------------------------------------------------------------------*/

/* Pin definitions and main prototypes */
#include "main.h"
#include "init.h"
#include "zav_pin_defines_A0002.h"
#include "zav_error.h"
#include "led.h"


/*------------------------------------------------------------------------------
 Application entry point                                                      
------------------------------------------------------------------------------*/
int main
	(
	void
	)
{
/*------------------------------------------------------------------------------
 MCU Initialization                                                                  
------------------------------------------------------------------------------*/
HAL_Init          ();
SystemClock_Config();
GPIO_Init         ();


/*------------------------------------------------------------------------------
 Event Loop                                                                  
------------------------------------------------------------------------------*/
while (1)
	{
	/* Loop over 8 basic rgb led settings */
	for ( uint8_t i = 0; i < 8; ++i )
		{
		if ( i == 0 ) /* Start with LED off */
			{
			led_reset();
			}
		else
			{
			led_set_color( i );
			}

		HAL_Delay( 500 );
        }
	}

} /* main.c */


/*******************************************************************************
* END OF FILE                                                                  *
*******************************************************************************/